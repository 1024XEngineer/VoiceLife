## components/voicelife_storage_fatfs/Kconfig
```kconfig
menu "VoiceLife FATFS 存储"

config VOICELIFE_STORAGE_FATFS
    bool "启用 FATFS/Wear Levelling 存储"
    default n
    help
        启用基于 ESP-IDF FATFS 和 Wear Levelling 的 Flash 数据卷。
        当前 Runtime 将 FATFS/WL 与 SQLite 作为一个完整持久化 Profile 启动，
        两个适配器必须同时启用，不能只挂载其中一层后报告存储就绪。
        正式挂载始终禁止挂载失败后自动格式化，以保留现场和用户数据。

config VOICELIFE_STORAGE_FATFS_RUNTIME
    bool
    default VOICELIFE_STORAGE_FATFS && VOICELIFE_STORAGE_SQLITE
    help
        仅在 FATFS/WL 与 SQLite 同时启用时激活 Runtime 存储装配。

config VOICELIFE_STORAGE_FATFS_PARTITION_LABEL
    string "Flash 数据分区标签"
    depends on VOICELIFE_STORAGE_FATFS
    default "voicelife"
    help
        分区表中用于 VoiceLife 持久化数据的 data 分区标签。

config VOICELIFE_STORAGE_FATFS_BASE_PATH
    string "FATFS 挂载路径"
    depends on VOICELIFE_STORAGE_FATFS
    default "/data"
    help
        FATFS 通过 VFS 暴露的路径前缀，例如 /data。

config VOICELIFE_STORAGE_FATFS_MAX_FILES
    int "最大同时打开文件数"
    depends on VOICELIFE_STORAGE_FATFS
    default 6
    range 1 32
    help
        FATFS VFS 允许同时打开的文件数量。

config VOICELIFE_STORAGE_FATFS_ALLOCATION_UNIT_SIZE
    int "FATFS 分配单元大小"
    depends on VOICELIFE_STORAGE_FATFS
    default 4096
    help
        格式化时使用的 FATFS 分配单元大小。生产适配器不会因挂载失败自动格式化，
        因此该值只影响显式初始化或未来的维护工具。

config VOICELIFE_STORAGE_FATFS_EXPECTED_PARTITION_ADDRESS
    hex "期望的 Flash 数据分区起始地址"
    depends on VOICELIFE_STORAGE_FATFS
    default 0x7E0000
    help
        非零时，挂载前严格校验分区表中的 voicelife 数据分区起始地址。
        设置为零可用于不固定板级布局的开发或主机配置。

config VOICELIFE_STORAGE_FATFS_EXPECTED_PARTITION_SIZE
    hex "期望的 Flash 数据分区大小"
    depends on VOICELIFE_STORAGE_FATFS
    default 0x200000
    help
        非零时，挂载前严格校验分区表中的数据分区容量。
        设置为零可用于不固定板级布局的开发或主机配置。

endmenu
```

## components/voicelife_storage_sqlite/Kconfig
```kconfig
menu "VoiceLife SQLite 存储"

config VOICELIFE_STORAGE_SQLITE
    bool "构建 SQLite 存储基础设施"
    default n
    help
        启用 SQLite 连接、Schema 迁移、完整性检查和日程仓储。
        当前设备 Runtime 固定以 FATFS/Wear Levelling 承载 SQLite 文件；
        只有两个适配器同时启用时，Runtime 才会启动持久化链路。
        构建前必须先准备固定版本的 sqlite3 组件。

endmenu
```

## main/Kconfig.projbuild
```kconfig
menu "VoiceLife"

choice VOICELIFE_BOARD
    prompt "Board assembly"
    default VOICELIFE_BOARD_VOICELIFE_PCB
    help
        构建期选定板级装配：Runtime 只依赖 PlatformAssembly 接口，
        不判断板型、不直接调用具体显示实现。

config VOICELIFE_BOARD_VOICELIFE_PCB
    bool "VoiceLife PCB（SSD1306 点阵屏）"

config VOICELIFE_BOARD_ESP_SPARKBOT
    bool "ESP-SparkBot（ST7789/LVGL 彩屏）"

endchoice

config VOICELIFE_IM_GATEWAY
    bool "Enable VoiceLife Gateway IM runtime"
    default n
    help
        Assemble the base IM runtime from the encrypted `im` NVS namespace.
        Missing or invalid configuration degrades IM without stopping local
        voice/audio. No schedule receipt, notification or SSE action task is
        started by this option.

config VOICELIFE_AUDIO_PROBE
    bool "Enable ESP32-S3 audio wiring probe"
    default n
    help
        Run the bounded I2S topology, PCM evidence and optional replay probe.

config VOICELIFE_AUDIO_PORT_SMOKE
    bool "Enable ESP32-S3 PCM Audio Port smoke"
    default n
    depends on IDF_TARGET_ESP32S3
    help
        Exercise the profile-driven PCM Audio Port with separate capture and
        playback tasks. This proves digital I2S and bounded queue behavior;
        it does not prove acoustic playback or a cloud voice session.

config VOICELIFE_STATE_FLOW_TEST
    bool "Enable SparkBot interaction state-flow diagnostic"
    default n
    depends on VOICELIFE_BOARD_ESP_SPARKBOT
    help
        Run a finite, low-priority diagnostic sequence through Runtime's
        InteractionEventLoop and VoiceSession evidence inlet. It never calls
        a renderer, presentation port, GPIO, or audio output directly. This
        is a test-only build option and must remain disabled in production.

config VOICELIFE_SERIAL_VOICE_TEST
    bool "Enable SparkBot serial PCM voice regression harness"
    default n
    depends on VOICELIFE_BOARD_ESP_SPARKBOT && ESP_CONSOLE_USB_SERIAL_JTAG && !VOICELIFE_STATE_FLOW_TEST
    help
        Start a test-only USB Serial/JTAG PCM input reader. It accepts a fixed,
        bounded 16 kHz S16LE mono protocol and routes frames through the normal
        audio queue, VoiceSession, Linx transport and ES8311 output. The test
        build emits unredacted voice text and detailed hardware telemetry for
        board diagnosis. It must remain disabled in production profiles.

config VOICELIFE_MCP_TOOLS
    bool "Enable VoiceLife MCP tool advertisement"
    default y
    help
        Register VoiceLife MCP tools while keeping the MCP worker available.
        Profiles that require an empty tool catalog must explicitly set this
        option to n.

if VOICELIFE_AUDIO_PROBE

choice VOICELIFE_AUDIO_PROBE_PROFILE
    prompt "Audio probe profile"
    default VOICELIFE_AUDIO_PROBE_PROFILE_LICHUANG

config VOICELIFE_AUDIO_PROBE_PROFILE_LICHUANG
    bool "ESP32-S3 Lichuang external Codec duplex"

config VOICELIFE_AUDIO_PROBE_PROFILE_VOICELIFE_PCB
    bool "ESP32-S3 VoiceLife PCB direct I2S simplex"

endchoice

config VOICELIFE_AUDIO_PROBE_REPLAY
    bool "Replay one attenuated captured PCM frame"
    default n
    help
        Write one bounded, attenuated frame after capture. This is a bus-level
        smoke only and never proves that the speaker was acoustically heard.

endif

endmenu
```

## sdkconfig.defaults
```kconfig
CONFIG_ESP_DEFAULT_CPU_FREQ_MHZ_240=y
CONFIG_COMPILER_CXX_EXCEPTIONS=n
CONFIG_COMPILER_CXX_RTTI=n
CONFIG_LOG_DEFAULT_LEVEL_INFO=y
CONFIG_ESPTOOLPY_FLASHSIZE_16MB=y
CONFIG_PARTITION_TABLE_CUSTOM=y
CONFIG_PARTITION_TABLE_CUSTOM_FILENAME="config/partitions/voicelife-16mb.csv"
CONFIG_FATFS_SECTOR_4096=y
CONFIG_WL_SECTOR_SIZE_4096=y
CONFIG_VOICELIFE_STORAGE_FATFS=y
CONFIG_VOICELIFE_STORAGE_SQLITE=y
# TLS 的 16 KiB 接收片段无法在语音/Wi-Fi 并发后的碎片化内部堆中稳定分配。
# 默认分配策略会让大缓冲使用已启用的 PSRAM，较小的会话状态仍遵循系统内部堆阈值。
# CONFIG_MBEDTLS_INTERNAL_MEM_ALLOC is not set
CONFIG_MBEDTLS_DEFAULT_MEM_ALLOC=y
```

## tests/board/sqlite_storage_probe/main/Kconfig.projbuild
```kconfig
menu "VoiceLife SQLite board probe"

config SQLITE_PROBE_PARTITION_LABEL
    string "Data partition label"
    default "voicelife"
    help
        Label of the existing 2 MiB data partition used by the probe.
        It must match --data-label passed to scripts/sqlite_board_probe.py.

config SQLITE_PROBE_ALLOW_FORMAT
    bool "Allow the probe to initialize its backed-up test partition"
    default y
    help
        This is only for the destructive board fixture. The host tool must back
        up and verify the selected partition before booting the probe.
        Production storage adapters must keep format_if_mount_failed disabled.

endmenu
```

## tests/board/sqlite_storage_probe/sdkconfig.defaults
```kconfig
CONFIG_IDF_TARGET="esp32s3"
CONFIG_ESPTOOLPY_FLASHSIZE_16MB=y
CONFIG_PARTITION_TABLE_CUSTOM=y
CONFIG_PARTITION_TABLE_CUSTOM_FILENAME="partitions.csv"
CONFIG_FREERTOS_HZ=1000
CONFIG_COMPILER_OPTIMIZATION_SIZE=y
CONFIG_LOG_DEFAULT_LEVEL_INFO=y
CONFIG_ESP_MAIN_TASK_STACK_SIZE=16384
CONFIG_VFS_SUPPORT_DIR=y
CONFIG_FATFS_SECTOR_4096=y
CONFIG_WL_SECTOR_SIZE_4096=y
CONFIG_SQLITE_PROBE_PARTITION_LABEL="voicelife"
CONFIG_SQLITE_PROBE_ALLOW_FORMAT=y
```

## tests/board/timing_esp_unity/sdkconfig.defaults
```kconfig
CONFIG_IDF_TARGET="esp32s3"
CONFIG_FREERTOS_UNICORE=y
CONFIG_FREERTOS_HZ=1000
CONFIG_COMPILER_OPTIMIZATION_SIZE=y
CONFIG_LOG_DEFAULT_LEVEL_INFO=y
CONFIG_ESP_MAIN_TASK_STACK_SIZE=8192
```
